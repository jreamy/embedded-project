//------------------------------------------------------------------------------
//             __             __   ___  __
//     | |\ | /  ` |    |  | |  \ |__  /__`
//     | | \| \__, |___ \__/ |__/ |___ .__/
//
//------------------------------------------------------------------------------

#include "i2c_mux.h"
#include "i2c.h"

//------------------------------------------------------------------------------
//      __   ___  ___         ___  __
//     |  \ |__  |__  | |\ | |__  /__`
//     |__/ |___ |    | | \| |___ .__/
//
//------------------------------------------------------------------------------

#define I2C_MUX_DATA (0)
#define I2C_MUX_STOP (1)
#define I2C_MUX_DONE (2)

//------------------------------------------------------------------------------
//     ___      __   ___  __   ___  ___  __
//      |  \ / |__) |__  |  \ |__  |__  /__`
//      |   |  |    |___ |__/ |___ |    .__/
//
//------------------------------------------------------------------------------

//------------------------------------------------------------------------------
//                __          __        ___  __
//     \  /  /\  |__) |  /\  |__) |    |__  /__`
//      \/  /~~\ |  \ | /~~\ |__) |___ |___ .__/
//
//------------------------------------------------------------------------------

uint8_t _i2c_mux_data;
uint8_t _i2c_mux_state;

//------------------------------------------------------------------------------
//      __   __   __  ___  __  ___      __   ___  __
//     |__) |__) /  \  |  /  \  |  \ / |__) |__  /__`
//     |    |  \ \__/  |  \__/  |   |  |    |___ .__/
//
//------------------------------------------------------------------------------

uint8_t _i2c_mux_callback();

//------------------------------------------------------------------------------
//      __        __          __
//     |__) |  | |__) |    | /  `
//     |    \__/ |__) |___ | \__,
//
//------------------------------------------------------------------------------

//==============================================================================
void i2c_mux_init(uint8_t addr, uint8_t data)
{
    while (i2c_registered());
    while (!i2c_mux_write(addr, data));
    while (i2c_registered());
}

//==============================================================================
uint8_t i2c_mux_write(uint8_t addr, uint8_t data) {
    if (i2c_register(_i2c_mux_callback)) {
        _i2c_mux_data = data;
        _i2c_mux_state = I2C_MUX_DATA;
        i2c_begin_write(addr);
        return 1;
    }
    return 0;
}

uint8_t i2c_mux_write_complete() {
    return (_i2c_mux_state == I2C_MUX_DONE);
}

//------------------------------------------------------------------------------
//      __   __              ___  ___
//     |__) |__) | \  /  /\   |  |__
//     |    |  \ |  \/  /~~\  |  |___
//
//------------------------------------------------------------------------------

//------------------------------------------------------------------------------
//      __                  __        __        __
//     /  `  /\  |    |    |__)  /\  /  ` |__/ /__`
//     \__, /~~\ |___ |___ |__) /~~\ \__, |  \ .__/
//
//------------------------------------------------------------------------------

uint8_t _i2c_mux_callback() {
    uint8_t complete = 0;

    switch (_i2c_mux_state) {
        case I2C_MUX_DATA: {
            _i2c_mux_state = I2C_MUX_STOP;
            i2c_write(_i2c_mux_data);
        } break;

        case I2C_MUX_STOP: {
            _i2c_mux_state = I2C_MUX_DONE;
            complete = 1;
            i2c_tx_stop();
        } break;
    } // end switch

    return complete;
}

//------------------------------------------------------------------------------
//        __   __  , __
//     | /__` |__)  /__`   
//     | .__/ |  \  .__/
//
//------------------------------------------------------------------------------
